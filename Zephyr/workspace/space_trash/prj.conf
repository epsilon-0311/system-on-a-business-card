## CMakeLists.txt
```
#-------------------------------------------------------------------------------
# Zephyr Example Application
#
# Copyright (c) 2021 Nordic Semiconductor ASA
# SPDX-License-Identifier: Apache-2.0

cmake_minimum_required(VERSION 3.20.0)
find_package(Zephyr REQUIRED HINTS $ENV{ZEPHYR_BASE})

project(space_trash LANGUAGES C VERSION 1.0.0)

configure_file(app_version.h.in ${CMAKE_BINARY_DIR}/app/include/app_version.h)
target_include_directories(app PRIVATE ${CMAKE_BINARY_DIR}/app/include src)
target_include_directories(app PRIVATE ${CMAKE_BINARY_DIR}/app/include inc)

target_sources(app PRIVATE src/controls.c)
target_sources(app PRIVATE src/graphics.c)
target_sources(app PRIVATE src/game.c)
target_sources(app PRIVATE src/images.c)
target_sources(app PRIVATE src/main.c)
target_sources(app PRIVATE src/nvm.c)
```

## prj.conf
```kconfig
# Copyright (c) 2021 Nordic Semiconductor ASA
# SPDX-License-Identifier: Apache-2.0
#
# This file contains selected Kconfig options for the application.

CONFIG_SERIAL=y
CONFIG_CONSOLE=y
CONFIG_UART_CONSOLE=y
CONFIG_UART_LINE_CTRL=y

CONFIG_GPIO=y

CONFIG_LOG=y
CONFIG_LOG_MODE_DEFERRED=y
CONFIG_LOG_RUNTIME_FILTERING=y
CONFIG_LOG_BUFFER_SIZE=2048
CONFIG_LOG_PRINTK=y
CONFIG_LOG_PROCESS_TRIGGER_THRESHOLD=0
CONFIG_COVERAGE=n
CONFIG_LOG_TAG_MAX_LEN=8
CONFIG_MINIMAL_LIBC_RAND=y

CONFIG_DISPLAY=y

CONFIG_LVGL=y
CONFIG_LV_Z_MEM_POOL_NUMBER_BLOCKS=8
CONFIG_LV_MEM_CUSTOM=y
CONFIG_LV_USE_LOG=y
CONFIG_LV_USE_LABEL=y
CONFIG_LV_USE_IMG=y

CONFIG_LV_FONT_MONTSERRAT_8=y
CONFIG_LV_FONT_MONTSERRAT_10=y
CONFIG_LV_FONT_MONTSERRAT_12=y
CONFIG_LV_FONT_MONTSERRAT_16=y
CONFIG_LV_FONT_MONTSERRAT_18=y
CONFIG_LV_FONT_MONTSERRAT_20=y
CONFIG_LV_FONT_MONTSERRAT_22=y
#CONFIG_LV_FONT_MONTSERRAT_24=y
#CONFIG_LV_FONT_MONTSERRAT_26=y
#CONFIG_LV_FONT_MONTSERRAT_28=y
#CONFIG_LV_FONT_MONTSERRAT_30=y
#CONFIG_LV_FONT_MONTSERRAT_32=y
#CONFIG_LV_FONT_MONTSERRAT_34=y
#CONFIG_LV_FONT_MONTSERRAT_36=y
#CONFIG_LV_FONT_MONTSERRAT_38=y
#CONFIG_LV_FONT_MONTSERRAT_40=y
#CONFIG_LV_FONT_MONTSERRAT_42=y
#CONFIG_LV_FONT_MONTSERRAT_44=y
#CONFIG_LV_FONT_MONTSERRAT_46=y
#CONFIG_LV_FONT_MONTSERRAT_48=y

CONFIG_LV_USE_THEME_DEFAULT=y
CONFIG_LV_THEME_DEFAULT_DARK=y

# enable flash
CONFIG_FLASH=y
CONFIG_FLASH_PAGE_LAYOUT=y
CONFIG_NVS=y
CONFIG_NVS_LOG_LEVEL_DBG=y
CONFIG_MPU_ALLOW_FLASH_WRITE=y
CONFIG_HEAP_MEM_POOL_SIZE=256
```

## src/main.c
```c
/*
 * Copyright (c) 2019 Nordic Semiconductor ASA
 *
 * SPDX-License-Identifier: Apache-2.0
 */


#include <zephyr/kernel.h>
#include <zephyr/device.h>
#include <zephyr/drivers/gpio.h>
#include <zephyr/drivers/display.h>
#include <zephyr/sys/util.h>
#include <zephyr/sys/printk.h>
#include <inttypes.h>

#include <lvgl.h>

#include <stdio.h>
#include <string.h>
#include <math.h>

#include "graphics.h"
#include "controls.h"
#include "game.h"
#include "nvm.h"

#include <zephyr/logging/log.h>
LOG_MODULE_REGISTER(main, LOG_LEVEL_DBG);

#include "app_version.h"
void main(void)
{
	printk("Zephyr Example Application %s\n", APP_VERSION_STR);

	controls_init(false);
	graphics_init();
	nvm_init();
	//graphics_demo();
	game_init();
	controls_btn_states_t control_inputs;
	while (1)
	{
		controls_get_button_states(&control_inputs);
		game_step(&control_inputs);
		graphics_update_screen();

		k_sleep(K_MSEC(25));
		//printk("Hello, world!\n");
	}
}
```

## inc/controls.h
```c
#ifndef __SPACE_TRASH_CONTROLS_H__
#define __SPACE_TRASH_CONTROLS_H__

#include <inttypes.h>

typedef union  btn_states
{
    struct 
    {
        /* data */
        uint16_t btn_a:1;
        uint16_t btn_b:1;
        uint16_t btn_x:1;
        uint16_t btn_y:1;
        uint16_t btn_up:1;
        uint16_t btn_left:1;
        uint16_t btn_down:1;
        uint16_t btn_right:1;
        uint16_t btn_select:1;
        uint16_t btn_start:1;
    };
    uint16_t bf;
} controls_btn_states_t;

int controls_init(bool enable_interupts);

void controls_get_button_states(controls_btn_states_t* states);

#endif
```

## inc/game.h
```c
#ifndef __SPACE_TRASH_GAME_H__
#define __SPACE_TRASH_GAME_H__

#include "controls.h"

#ifndef SCORE_BOARD_ENTRIES
    #define SCORE_BOARD_ENTRIES 3
#endif

#ifndef SCORE_BOARD_MAX_NAME_LENGTH
    #define SCORE_BOARD_MAX_NAME_LENGTH 10
#endif

#ifndef MISSILE_COOLDOWN
    #define MISSILE_COOLDOWN 10
#endif

#ifndef MAX_MISSILE_COUNTER
    #define MAX_MISSILE_COUNTER 10
#endif

#ifndef MAX_TRASH_COUNTER
    #define MAX_TRASH_COUNTER 20
#endif

#ifndef MAX_TRASH_COOLDOWN
    #define MAX_TRASH_COOLDOWN 75
#endif

#ifndef MIN_TRASH_COOLDOWN
    #define MIN_TRASH_COOLDOWN 5
#endif

#ifndef ITERATIONS_PER_LEVEL
    #define ITERATIONS_PER_LEVEL 250
#endif

#ifndef LEVEL_COOLDOWN_REDUCTION
    #define LEVEL_COOLDOWN_REDUCTION 5
#endif



// forward increment of pixels per iteration
#ifndef PLAYER_SPEED
    #define PLAYER_SPEED 1
#endif

// forward increment of pixels per iteration
#ifndef MISSILE_SPEED
    #define MISSILE_SPEED PLAYER_SPEED+1
#endif

// forward increment of pixels per iteration
#ifndef TRASH_SPEED
    #define TRASH_SPEED 1
#endif



typedef enum{
    GAME_STATE_INIT,
    GAME_STATE_START,
    GAME_STATE_PRE_RUN,
    GAME_STATE_RUN,
    GAME_STATE_POST_RUN,
    GAME_STATE_PRE_SCORE_BOARD,
    GAME_STATE_SCORE_BOARD,
} game_state_t;

void game_init(void);

void game_step(controls_btn_states_t *control_inputs);


#endif
```

## inc/graphics.h
```c
#ifndef __SPACE_TRASH_GRAPHICS_H__
#define __SPACE_TRASH_GRAPHICS_H__

#include <stdio.h>
#include <inttypes.h>
#include <lvgl.h>

#ifndef MAX_GRAPHICS_OBJECTS
    #define MAX_GRAPHICS_OBJECTS 50
#endif

int graphics_init(void);

void graphics_get_screen_size(uint16_t *height, uint16_t*width);

void graphics_update_screen(void);

void graphics_demo(void);

uint8_t graphics_draw_image(const lv_img_dsc_t *image, int16_t x, int16_t y);

uint8_t graphics_draw_text(const char *text, int16_t x, int16_t y, uint8_t font_size);

uint8_t graphics_draw_line(const lv_point_t* points, uint8_t num_points, uint8_t line_width);

uint8_t graphics_create_text_area( int16_t x, int16_t y, uint16_t height, uint8_t max_length, uint8_t font_size);

uint8_t graphics_text_input_screen( int16_t x, int16_t y, uint16_t height, uint8_t ta_obj_id, void (*cb_func)(const char *));

uint8_t graphics_draw_table(int16_t x, int16_t y, uint16_t width, uint16_t height, uint8_t row_cnt, uint8_t column_cnt, uint16_t * col_widths,  uint8_t font_size);

int graphics_table_set_cell_value(uint8_t graphics_obj_id, uint16_t row, uint16_t col, char *text);

int graphics_set_font_size(uint8_t obj_id, uint8_t size);

int graphics_set_text(uint8_t obj_id, char *text);

int graphics_move_object(uint8_t obj_id, int16_t offset_x, int16_t offset_y, bool wrap_around);

int graphics_set_alignment(uint8_t obj_id, lv_align_t align);

int graphics_set_object_position(uint8_t obj_id, int16_t x, int16_t y);

int graphics_get_object_position(uint8_t obj_id, int16_t *x, int16_t *y);

int graphics_get_object_dimensions(uint8_t obj_id, int16_t *height, int16_t *width);

int graphics_delete_object(uint8_t obj_id);

void graphics_delete_all_objects(void);

#endif
```

## inc/images.h
```c
#ifndef __SPACE_TRASH_IMAGES_H__
#define __SPACE_TRASH_IMAGES_H__

extern const lv_img_dsc_t st_bitmap_player1;
extern const lv_img_dsc_t st_bitmap_player2;
extern const lv_img_dsc_t st_bitmap_player3;

extern const lv_img_dsc_t st_bitmap_trash_5x5_1;
extern const lv_img_dsc_t st_bitmap_trash_5x5_2;
extern const lv_img_dsc_t st_bitmap_trash_7x7;

extern const lv_img_dsc_t st_bitmap_gadget;
extern const lv_img_dsc_t st_bitmap_missile;

#endif
```

## inc/nvm.h
```c
#ifndef __SPACE_TRASH_NVM_H__
#define __SPACE_TRASH_NVM_H__

#include <stdio.h>
#include <inttypes.h>

int nvm_init(void);

int nvm_read(uint16_t nv_id, uint8_t *data, uint16_t data_size, bool initialize, uint8_t *init_data);

int nvm_write(uint16_t nv_id, uint8_t *data, uint16_t data_size);

#endif
```

## inc/space_trash.h
```c
#ifndef __SPACE_TRASH_H__
#define __SPACE_TRASH_H__

#define ST_FP 4

#define ST_DRAW_NONE 0
#define ST_DRAW_BBOX 1
#define ST_DRAW_TRASH1 2
#define ST_DRAW_PLAYER1 3
#define ST_DRAW_TRASH2 4
#define ST_DRAW_PLAYER2 5
#define ST_DRAW_PLAYER3 6
#define ST_DRAW_GADGET 7
#define ST_DRAW_BACKSLASH 8
#define ST_DRAW_SLASH 9
#define ST_DRAW_BIG_TRASH 10

#define ST_MOVE_NONE 0
#define ST_MOVE_X_SLOW 1
#define ST_MOVE_PX_NORMAL 2
#define ST_MOVE_PX_FAST 3
#define ST_MOVE_PLAYER 4
#define ST_MOVE_PY 5
#define ST_MOVE_NY 6
#define ST_MOVE_IMPLODE 7
#define ST_MOVE_X_FAST 8
#define ST_MOVE_WALL 9
#define ST_MOVE_NXPY 10
#define ST_MOVE_NXNY 11

#define ST_IS_HIT_NONE 0
#define ST_IS_HIT_BBOX 1
#define ST_IS_HIT_WALL 2

#define ST_DESTROY_NONE 0
#define ST_DESTROY_DISAPPEAR 1
#define ST_DESTROY_TO_DUST 2
#define ST_DESTROY_GADGET 3
#define ST_DESTROY_PLAYER 4
#define ST_DESTROY_PLAYER_GADGETS 5
#define ST_DESTROY_BIG_TRASH 6

#define ST_FIRE_NONE 0
#define ST_FIRE_PLAYER1 1
#define ST_FIRE_PLAYER2 2
#define ST_FIRE_PLAYER3 3

#define ST_OT_WALL_SOLID 1
#define ST_OT_BIG_TRASH 2
#define ST_OT_MISSLE 3
#define ST_OT_TRASH1 4
#define ST_OT_PLAYER 5
#define ST_OT_DUST_PY 6
#define ST_OT_DUST_NY 7
#define ST_OT_TRASH_IMPLODE 8
#define ST_OT_TRASH2 9
#define ST_OT_PLAYER2 10
#define ST_OT_PLAYER3 11
#define ST_OT_GADGET 12
#define ST_OT_GADGET_IMPLODE 13
#define ST_OT_DUST_NXPY 14
#define ST_OT_DUST_NXNY 15

#ifndef ST_OBJ_CNT
    #define ST_OBJ_CNT 25
#endif

#ifndef ST_POINTS_PER_LEVEL
    #define ST_POINTS_PER_LEVEL 25
#endif 


/*================================================================*/
/* overall game state */
/*================================================================*/

#define ST_STATE_PREPARE 0
#define ST_STATE_IPREPARE 1
#define ST_STATE_GAME 2
#define ST_STATE_END 3
#define ST_STATE_IEND 4

/*================================================================*/
/* game difficulty */
/*================================================================*/
#ifndef ST_DIFF_VIS_LEN
    #define ST_DIFF_VIS_LEN 30
#endif 

#ifndef ST_DIFF_FP
    #define ST_DIFF_FP 5
#endif

#endif
```

## src/buttons.c
```c
#include <stdio.h>
#include <string.h>

#include <zephyr/kernel.h>
#include <zephyr/device.h>
#include <zephyr/drivers/gpio.h>
#include <zephyr/sys/util.h>
#include <inttypes.h>


#include <zephyr/logging/log.h>
LOG_MODULE_REGISTER(main, LOG_LEVEL_DBG);

#define BTN_START_NODE	DT_ALIAS(btn_start)
#if !DT_NODE_HAS_STATUS(BTN_START_NODE, okay)
	#error "Unsupported board: btn_start devicetree alias is not defined"
#endif
static const struct gpio_dt_spec btn_start = GPIO_DT_SPEC_GET_OR(BTN_START_NODE, gpios, {0});
static struct gpio_callback button_start_cb_data;

#define BTN_SELECT_NODE	DT_ALIAS(btn_select)
#if !DT_NODE_HAS_STATUS(BTN_SELECT_NODE, okay)
	#error "Unsupported board: btn_select devicetree alias is not defined"
#endif
static const struct gpio_dt_spec btn_select = GPIO_DT_SPEC_GET_OR(BTN_SELECT_NODE, gpios, {0});
static struct gpio_callback button_select_cb_data;

#define BTN_UP_NODE	DT_ALIAS(btn_up)
#if !DT_NODE_HAS_STATUS(BTN_UP_NODE, okay)
	#error "Unsupported board: btn_up devicetree alias is not defined"
#endif
static const struct gpio_dt_spec btn_up = GPIO_DT_SPEC_GET_OR(BTN_UP_NODE, gpios, {0});
static struct gpio_callback button_up_cb_data;

#define BTN_DOWN_NODE	DT_ALIAS(btn_down)
#if !DT_NODE_HAS_STATUS(BTN_DOWN_NODE, okay)
	#error "Unsupported board: btn_down devicetree alias is not defined"
#endif
static const struct gpio_dt_spec btn_down = GPIO_DT_SPEC_GET_OR(BTN_DOWN_NODE, gpios, {0});
static struct gpio_callback button_down_cb_data;

#define BTN_LEFT_NODE	DT_ALIAS(btn_left)
#if !DT_NODE_HAS_STATUS(BTN_LEFT_NODE, okay)
	#error "Unsupported board: btn_left devicetree alias is not defined"
#endif
static const struct gpio_dt_spec btn_left = GPIO_DT_SPEC_GET_OR(BTN_LEFT_NODE, gpios, {0});
static struct gpio_callback button_left_cb_data;

#define BTN_RIGHT_NODE	DT_ALIAS(btn_right)
#if !DT_NODE_HAS_STATUS(BTN_RIGHT_NODE, okay)
	#error "Unsupported board: btn_right devicetree alias is not defined"
#endif
static const struct gpio_dt_spec btn_right = GPIO_DT_SPEC_GET_OR(BTN_RIGHT_NODE, gpios, {0});
static struct gpio_callback button_right_cb_data;

#define BTN_A_NODE	DT_ALIAS(btn_a)
#if !DT_NODE_HAS_STATUS(BTN_A_NODE, okay)
	#error "Unsupported board: btn_a devicetree alias is not defined"
#endif
static const struct gpio_dt_spec btn_a = GPIO_DT_SPEC_GET_OR(BTN_A_NODE, gpios, {0});
static struct gpio_callback button_a_cb_data;

#define BTN_B_NODE	DT_ALIAS(btn_b)
#if !DT_NODE_HAS_STATUS(BTN_START_NODE, okay)
	#error "Unsupported board: btn_b devicetree alias is not defined"
#endif
static const struct gpio_dt_spec btn_b = GPIO_DT_SPEC_GET_OR(BTN_B_NODE, gpios, {0});
static struct gpio_callback button_b_cb_data;

#define BTN_X_NODE	DT_ALIAS(btn_x)
#if !DT_NODE_HAS_STATUS(BTN_X_NODE, okay)
	#error "Unsupported board: btn_x devicetree alias is not defined"
#endif
static const struct gpio_dt_spec btn_x = GPIO_DT_SPEC_GET_OR(BTN_X_NODE, gpios, {0});
static struct gpio_callback button_x_cb_data;

#define BTN_Y_NODE	DT_ALIAS(btn_y)
#if !DT_NODE_HAS_STATUS(BTN_Y_NODE, okay)
	#error "Unsupported board: btn_y devicetree alias is not defined"
#endif
static const struct gpio_dt_spec btn_y = GPIO_DT_SPEC_GET_OR(BTN_Y_NODE, gpios, {0});
static struct gpio_callback button_y_cb_data;

void btn_changed(const struct device *dev, struct gpio_callback *cb, uint32_t pins)
{
    int start = gpio_pin_get(btn_start.port, btn_start.pin);
    int select = gpio_pin_get(btn_select.port, btn_select.pin);
    int up = gpio_pin_get(btn_up.port, btn_up.pin);
    int down = gpio_pin_get(btn_down.port, btn_down.pin);
    int left = gpio_pin_get(btn_left.port, btn_left.pin);
    int right = gpio_pin_get(btn_right.port, btn_right.pin);
    int a = gpio_pin_get(btn_a.port, btn_a.pin);
    int b = gpio_pin_get(btn_b.port, btn_b.pin);
    int x = gpio_pin_get(btn_x.port, btn_x.pin);
    int y = gpio_pin_get(btn_y.port, btn_y.pin);

	LOG_DBG("Intr: Start:%i Select:%i Up:%i Down:%i Left:%i Right:%i A:%i B:%i X:%i Y:%i\n", start, select, up, down, left, right, a, b, x, y);
}


int init_button(const struct gpio_dt_spec *btn, struct gpio_callback *btn_cb_data)
{
	int ret=device_is_ready(btn->port);
	if (!ret) {
		LOG_ERR("Error: btn device %s is not ready\n", btn->port->name);
		return ret;
	}

	ret = gpio_pin_configure_dt(btn, GPIO_INPUT);
	if (ret != 0) {
		LOG_ERR("Error %d: failed to configure %s pin %d\n", ret, btn->port->name, btn->pin);
		return ret;
	}
	
	ret = gpio_pin_interrupt_configure_dt(btn, GPIO_INT_EDGE_BOTH);
	if (ret != 0) {
		LOG_ERR("Error %d: failed to configure interrupt on %s pin %d\n", ret, btn->port->name, btn_start.pin);
		return ret;
	}

	gpio_init_callback(btn_cb_data, btn_changed, BIT(btn->pin));
	gpio_add_callback(btn->port, btn_cb_data);

	return 0;
}

int init_buttons(void)
{
    int ret = init_button(&btn_start, &button_start_cb_data);
	if(ret != 0)
	{
		LOG_ERR("Error: btn device %s, btn_start initialisation error\n", btn_start.port->name);
		return ret;
	}
	LOG_DBG("Set up btn_start at %s pin %d successfull\n", btn_start.port->name, btn_start.pin);


	ret = init_button(&btn_select, &button_select_cb_data);
	if(ret != 0)
	{
		LOG_ERR("Error: btn device %s, btn_select initialisation error\n", btn_select.port->name);
		return ret;
	}
	LOG_DBG("Set up btn_select at %s pin %d successfull\n", btn_select.port->name, btn_select.pin);


	ret = init_button(&btn_up, &button_up_cb_data);
	if(ret != 0)
	{
		LOG_ERR("Error: btn device %s, btn_up initialisation error\n", btn_up.port->name);
		return ret; 
	}
	LOG_DBG("Set up btn_upt at %s pin %d successfull\n", btn_up.port->name, btn_up.pin);


	ret = init_button(&btn_down, &button_down_cb_data);
	if(ret != 0)
	{
		LOG_ERR("Error: btn device %s, btn_down initialisation error\n", btn_down.port->name);
		return ret;
	}
	LOG_DBG("Set up btn_down at %s pin %d successfull\n", btn_down.port->name, btn_down.pin);


	ret = init_button(&btn_left, &button_left_cb_data);
	if(ret != 0)
	{
		LOG_ERR("Error: btn device %s, btn_left initialisation error\n", btn_left.port->name);
		return ret;
	}
	LOG_DBG("Set up btn_left at %s pin %d successfull\n", btn_left.port->name, btn_left.pin);


	ret = init_button(&btn_right, &button_right_cb_data);
	if(ret != 0)
	{
		LOG_ERR("Error: btn device %s, btn_right initialisation error\n", btn_right.port->name);
		return ret;
	}
	LOG_DBG("Set up btn_right at %s pin %d successfull\n", btn_right.port->name, btn_right.pin);


	ret = init_button(&btn_a, &button_a_cb_data);
	if(ret != 0)
	{
		LOG_ERR("Error: btn device %s, btn_a initialisation error\n", btn_a.port->name);
		return ret;
	}
	LOG_DBG("Set up btn_a at %s pin %d successfull\n", btn_a.port->name, btn_a.pin);


	ret = init_button(&btn_b, &button_b_cb_data);
	if(ret != 0)
	{
		LOG_ERR("Error: btn device %s, btn_b initialisation error\n", btn_b.port->name);
		return ret;
	}
	LOG_DBG("Set up btn_b at %s pin %d successfull\n", btn_b.port->name, btn_b.pin);

	ret = init_button(&btn_x, &button_x_cb_data);
	if(ret != 0)
	{
		LOG_ERR("Error: btn device %s, btn_x initialisation error\n", btn_x.port->name);
		return ret;
	}
	LOG_DBG("Set up btn_x at %s pin %d successfull\n", btn_x.port->name, btn_x.pin);


	ret = init_button(&btn_y, &button_y_cb_data);
	if(ret != 0)
	{
		LOG_ERR("Error: btn device %s, btn_y initialisation error\n", btn_y.port->name);
		return ret;
	}
	LOG_DBG("Set up btn_y at %s pin %d successfull\n", btn_y.port->name, btn_y.pin);

    return 0;
}
```

## src/controls.c
```c
/*
 * Copyright (c) 2019 Nordic Semiconductor ASA
 *
 * SPDX-License-Identifier: Apache-2.0
 */


#include <zephyr/kernel.h>
#include <zephyr/device.h>
#include <zephyr/drivers/gpio.h>
#include <zephyr/drivers/display.h>
#include <zephyr/sys/util.h>
#include <zephyr/sys/printk.h>
#include <inttypes.h>

#include <lvgl.h>

#include <stdio.h>
#include <string.h>
#include <math.h>

#include "controls.h"

#include <zephyr/logging/log.h>
LOG_MODULE_REGISTER(controls, LOG_LEVEL_INF);

#include "app_version.h"

#define BTN_START_NODE	DT_ALIAS(btn_start)
#if !DT_NODE_HAS_STATUS(BTN_START_NODE, okay)
	#error "Unsupported board: btn_start devicetree alias is not defined"
#endif
static const struct gpio_dt_spec btn_start = GPIO_DT_SPEC_GET_OR(BTN_START_NODE, gpios, {0});
static struct gpio_callback button_start_cb_data;

#define BTN_SELECT_NODE	DT_ALIAS(btn_select)
#if !DT_NODE_HAS_STATUS(BTN_SELECT_NODE, okay)
	#error "Unsupported board: btn_select devicetree alias is not defined"
#endif
static const struct gpio_dt_spec btn_select = GPIO_DT_SPEC_GET_OR(BTN_SELECT_NODE, gpios, {0});
static struct gpio_callback button_select_cb_data;

#define BTN_UP_NODE	DT_ALIAS(btn_up)
#if !DT_NODE_HAS_STATUS(BTN_UP_NODE, okay)
	#error "Unsupported board: btn_up devicetree alias is not defined"
#endif
static const struct gpio_dt_spec btn_up = GPIO_DT_SPEC_GET_OR(BTN_UP_NODE, gpios, {0});
static struct gpio_callback button_up_cb_data;

#define BTN_DOWN_NODE	DT_ALIAS(btn_down)
#if !DT_NODE_HAS_STATUS(BTN_DOWN_NODE, okay)
	#error "Unsupported board: btn_down devicetree alias is not defined"
#endif
static const struct gpio_dt_spec btn_down = GPIO_DT_SPEC_GET_OR(BTN_DOWN_NODE, gpios, {0});
static struct gpio_callback button_down_cb_data;

#define BTN_LEFT_NODE	DT_ALIAS(btn_left)
#if !DT_NODE_HAS_STATUS(BTN_LEFT_NODE, okay)
	#error "Unsupported board: btn_left devicetree alias is not defined"
#endif
static const struct gpio_dt_spec btn_left = GPIO_DT_SPEC_GET_OR(BTN_LEFT_NODE, gpios, {0});
static struct gpio_callback button_left_cb_data;

#define BTN_RIGHT_NODE	DT_ALIAS(btn_right)
#if !DT_NODE_HAS_STATUS(BTN_RIGHT_NODE, okay)
	#error "Unsupported board: btn_right devicetree alias is not defined"
#endif
static const struct gpio_dt_spec btn_right = GPIO_DT_SPEC_GET_OR(BTN_RIGHT_NODE, gpios, {0});
static struct gpio_callback button_right_cb_data;

#define BTN_A_NODE	DT_ALIAS(btn_a)
#if !DT_NODE_HAS_STATUS(BTN_A_NODE, okay)
	#error "Unsupported board: btn_a devicetree alias is not defined"
#endif
static const struct gpio_dt_spec btn_a = GPIO_DT_SPEC_GET_OR(BTN_A_NODE, gpios, {0});
static struct gpio_callback button_a_cb_data;

#define BTN_B_NODE	DT_ALIAS(btn_b)
#if !DT_NODE_HAS_STATUS(BTN_START_NODE, okay)
	#error "Unsupported board: btn_b devicetree alias is not defined"
#endif
static const struct gpio_dt_spec btn_b = GPIO_DT_SPEC_GET_OR(BTN_B_NODE, gpios, {0});
static struct gpio_callback button_b_cb_data;

#define BTN_X_NODE	DT_ALIAS(btn_x)
#if !DT_NODE_HAS_STATUS(BTN_X_NODE, okay)
	#error "Unsupported board: btn_x devicetree alias is not defined"
#endif
static const struct gpio_dt_spec btn_x = GPIO_DT_SPEC_GET_OR(BTN_X_NODE, gpios, {0});
static struct gpio_callback button_x_cb_data;

#define BTN_Y_NODE	DT_ALIAS(btn_y)
#if !DT_NODE_HAS_STATUS(BTN_Y_NODE, okay)
	#error "Unsupported board: btn_y devicetree alias is not defined"
#endif
static const struct gpio_dt_spec btn_y = GPIO_DT_SPEC_GET_OR(BTN_Y_NODE, gpios, {0});
static struct gpio_callback button_y_cb_data;

static controls_btn_states_t btn_states;
static bool interupts_enabled;

void btn_changed(const struct device *dev, struct gpio_callback *cb, uint32_t pins)
{
    btn_states.btn_start = gpio_pin_get(btn_start.port, btn_start.pin);
    btn_states.btn_select = gpio_pin_get(btn_select.port, btn_select.pin);
    btn_states.btn_up = gpio_pin_get(btn_up.port, btn_up.pin);
    btn_states.btn_down = gpio_pin_get(btn_down.port, btn_down.pin);
    btn_states.btn_left = gpio_pin_get(btn_left.port, btn_left.pin);
    btn_states.btn_right = gpio_pin_get(btn_right.port, btn_right.pin);
    btn_states.btn_a = gpio_pin_get(btn_a.port, btn_a.pin);
    btn_states.btn_b = gpio_pin_get(btn_b.port, btn_b.pin);
    btn_states.btn_x = gpio_pin_get(btn_x.port, btn_x.pin);
    btn_states.btn_y = gpio_pin_get(btn_y.port, btn_y.pin);

	LOG_DBG("Intr: Start:%i Select:%i Up:%i Down:%i Left:%i Right:%i A:%i B:%i X:%i Y:%i\n",
		btn_states.btn_start, btn_states.btn_select, 
		btn_states.btn_up, btn_states.btn_down, btn_states.btn_left, btn_states.btn_right, 
		btn_states.btn_a, btn_states.btn_b, btn_states.btn_x, btn_states.btn_y);
}

int init_button(const struct gpio_dt_spec *btn, struct gpio_callback *btn_cb_data, bool enable_interupts)
{
	int ret=device_is_ready(btn->port);
	if (!ret) {
		LOG_ERR("Error: btn device %s is not ready\n", btn->port->name);
		return ret;
	}

	ret = gpio_pin_configure_dt(btn, GPIO_INPUT);
	if (ret != 0) {
		LOG_ERR("Error %d: failed to configure %s pin %d\n", ret, btn->port->name, btn->pin);
		return ret;
	}
	
	if(enable_interupts == true)
	{
		ret = gpio_pin_interrupt_configure_dt(btn, GPIO_INT_EDGE_BOTH);
		if (ret != 0) {
			LOG_ERR("Error %d: failed to configure interrupt on %s pin %d\n", ret, btn->port->name, btn_start.pin);
			return ret;
		}

		gpio_init_callback(btn_cb_data, btn_changed, BIT(btn->pin));
		gpio_add_callback(btn->port, btn_cb_data);
	}

	return 0;
}

int controls_init(bool enable_interupts)
{
	
	int ret = init_button(&btn_start, &button_start_cb_data, enable_interupts);
	if(ret != 0)
	{
		LOG_ERR("Error: btn device %s, btn_start initialisation error\n", btn_start.port->name);
		return ret;
	}
	LOG_DBG("Set up btn_start at %s pin %d successfull\n", btn_start.port->name, btn_start.pin);


	ret = init_button(&btn_select, &button_select_cb_data, enable_interupts);
	if(ret != 0)
	{
		LOG_ERR("Error: btn device %s, btn_select initialisation error\n", btn_select.port->name);
		return ret;
	}
	LOG_DBG("Set up btn_select at %s pin %d successfull\n", btn_select.port->name, btn_select.pin);


	ret = init_button(&btn_up, &button_up_cb_data, enable_interupts);
	if(ret != 0)
	{
		LOG_ERR("Error: btn device %s, btn_up initialisation error\n", btn_up.port->name);
		return ret;
	}
	LOG_DBG("Set up btn_upt at %s pin %d successfull\n", btn_up.port->name, btn_up.pin);


	ret = init_button(&btn_down, &button_down_cb_data, enable_interupts);
	if(ret != 0)
	{
		LOG_ERR("Error: btn device %s, btn_down initialisation error\n", btn_down.port->name);
		return ret;
	}
	LOG_DBG("Set up btn_down at %s pin %d successfull\n", btn_down.port->name, btn_down.pin);


	ret = init_button(&btn_left, &button_left_cb_data, enable_interupts);
	if(ret != 0)
	{
		LOG_ERR("Error: btn device %s, btn_left initialisation error\n", btn_left.port->name);
		return ret;
	}
	LOG_DBG("Set up btn_left at %s pin %d successfull\n", btn_left.port->name, btn_left.pin);


	ret = init_button(&btn_right, &button_right_cb_data, enable_interupts);
	if(ret != 0)
	{
		LOG_ERR("Error: btn device %s, btn_right initialisation error\n", btn_right.port->name);
		return ret;
	}
	LOG_DBG("Set up btn_right at %s pin %d successfull\n", btn_right.port->name, btn_right.pin);


	ret = init_button(&btn_a, &button_a_cb_data, enable_interupts);
	if(ret != 0)
	{
		LOG_ERR("Error: btn device %s, btn_a initialisation error\n", btn_a.port->name);
		return ret;
	}
	LOG_DBG("Set up btn_a at %s pin %d successfull\n", btn_a.port->name, btn_a.pin);


	ret = init_button(&btn_b, &button_b_cb_data, enable_interupts);
	if(ret != 0)
	{
		LOG_ERR("Error: btn device %s, btn_b initialisation error\n", btn_b.port->name);
		return ret;
	}
	LOG_DBG("Set up btn_b at %s pin %d successfull\n", btn_b.port->name, btn_b.pin);

	ret = init_button(&btn_x, &button_x_cb_data, enable_interupts);
	if(ret != 0)
	{
		LOG_ERR("Error: btn device %s, btn_x initialisation error\n", btn_x.port->name);
		return ret;
	}
	LOG_DBG("Set up btn_x at %s pin %d successfull\n", btn_x.port->name, btn_x.pin);


	ret = init_button(&btn_y, &button_y_cb_data, enable_interupts);
	if(ret != 0)
	{
		LOG_ERR("Error: btn device %s, btn_y initialisation error\n", btn_y.port->name);
		return ret;
	}
	LOG_DBG("Set up btn_y at %s pin %d successfull\n", btn_y.port->name, btn_y.pin);

	btn_states.btn_start = gpio_pin_get(btn_start.port, btn_start.pin);
    btn_states.btn_select = gpio_pin_get(btn_select.port, btn_select.pin);
    btn_states.btn_up = gpio_pin_get(btn_up.port, btn_up.pin);
    btn_states.btn_down = gpio_pin_get(btn_down.port, btn_down.pin);
    btn_states.btn_left = gpio_pin_get(btn_left.port, btn_left.pin);
    btn_states.btn_right = gpio_pin_get(btn_right.port, btn_right.pin);
    btn_states.btn_a = gpio_pin_get(btn_a.port, btn_a.pin);
    btn_states.btn_b = gpio_pin_get(btn_b.port, btn_b.pin);
    btn_states.btn_x = gpio_pin_get(btn_x.port, btn_x.pin);
    btn_states.btn_y = gpio_pin_get(btn_y.port, btn_y.pin);

	interupts_enabled = enable_interupts;
	return 0;
}

void controls_get_button_states(controls_btn_states_t* states)
{
	if(interupts_enabled == false)
	{
		states->btn_start   = gpio_pin_get(btn_start.port, btn_start.pin);
		states->btn_select  = gpio_pin_get(btn_select.port, btn_select.pin);
		states->btn_up      = gpio_pin_get(btn_up.port, btn_up.pin);
		states->btn_down    = gpio_pin_get(btn_down.port, btn_down.pin);
		states->btn_left    = gpio_pin_get(btn_left.port, btn_left.pin);
		states->btn_right   = gpio_pin_get(btn_right.port, btn_right.pin);
		states->btn_a       = gpio_pin_get(btn_a.port, btn_a.pin);
		states->btn_b       = gpio_pin_get(btn_b.port, btn_b.pin);
		states->btn_x       = gpio_pin_get(btn_x.port, btn_x.pin);
		states->btn_y       = gpio_pin_get(btn_y.port, btn_y.pin);
	}
    else 
    {
	    *states = btn_states;
    }
	LOG_DBG("Intr: Start:%i Select:%i Up:%i Down:%i Left:%i Right:%i A:%i B:%i X:%i Y:%i\n",
		states->btn_start, states->btn_select, 
		states->btn_up, states->btn_down, states->btn_left, states->btn_right, 
		states->btn_a, states->btn_b, states->btn_x, states->btn_y);
}
```

## src/display.c
```c
#include <zephyr/kernel.h>
#include <zephyr/device.h>
#include <zephyr/drivers/gpio.h>
#include <zephyr/drivers/display.h>
#include <zephyr/sys/util.h>
#include <zephyr/sys/printk.h>
#include <inttypes.h>

#include <lvgl.h>

#include <stdio.h>
#include <string.h>
#include <math.h>

#include <zephyr/logging/log.h>
LOG_MODULE_REGISTER(buttons, LOG_LEVEL_DBG);

#define ZEPHYR_DISPLAY	DT_CHOSEN(zephry_display)
#if !DT_HAS_CHOSEN(ZEPHYR_DISPLAY)
	#error "Unsupported board: zephyr,display devicetree chosen is not defined"
#endif

#if ! DT_NODE_HAS_PROP(ZEPHYR_DISPLAY, width) || !DT_NODE_HAS_PROP(ZEPHYR_DISPLAY, height) 
    #error "Unsupported board: the used display is not supported"
#endif

#define DISPLAY_WIDTH  DT_PROP(ZEPHYR_DISPLAY, width)
#define DISPLAY_HEIGHT DT_PROP(ZEPHYR_DISPLAY, height)

static lv_obj_t *canvas;

static lv_color_t cbuf[LV_CANVAS_BUF_SIZE_INDEXED_1BIT(DISPLAY_WIDTH, DISPLAY_HEIGHT)]

static lv_color_t black;
static lv_color_t white;





void init_display(void)
{	
	const struct device *display_dev;
	lv_obj_t *text_label;

	display_dev = DEVICE_DT_GET(DT_CHOSEN(zephyr_display));
	if (!device_is_ready(display_dev)) {
		LOG_ERR("Device not ready, aborting test");
		return -ENODEV;
	}

    canvas = lv_canvas_create(lv_scr_act(), NULL);

    lv_canvas_set_buffer(canvas, cbuf, DISPLAY_WIDTH, DISPLAY_HEIGHT, LV_IMG_CF_INDEXED_1BIT);
    lv_canvas_set_palette(canvas, 0, LV_COLOR_BLACK);
    lv_canvas_set_palette(canvas, 1, LV_COLOR_WHITE);
    /*Create colors with the indices of the palette*/
    black.full = 0;
    white.full = 1;
    
    // fill background
    lv_canvas_fill_bg(canvas, black, LV_OPA_TRANSP);

    /*
	if (IS_ENABLED(CONFIG_LV_Z_POINTER_KSCAN)) {
		lv_obj_t *hello_world_button;

		hello_world_button = lv_btn_create(lv_scr_act());
		lv_obj_align(hello_world_button, LV_ALIGN_CENTER, 0, 0);
		text_label = lv_label_create(hello_world_button);
	} else {
		text_label = lv_label_create(lv_scr_act());
	}
    */

	// Create Label on the left side with the text
	//lv_label_set_text(text_label, "Hello, World!");
	//lv_obj_align(text_label, LV_ALIGN_TOP_LEFT, 0, 0);

	lv_task_handler();
	display_blanking_off(display_dev);

}
```

## src/game.c
```c
#include <zephyr/kernel.h>
#include <zephyr/device.h>
#include <zephyr/drivers/gpio.h>
#include <zephyr/drivers/display.h>
#include <zephyr/sys/util.h>
#include <zephyr/sys/printk.h>
#include <inttypes.h>

#include <time.h>
#include <stdlib.h>
#include <stdio.h>
#include <string.h>
#include <math.h>

#include <lvgl.h>

#include "graphics.h"
#include "images.h"
#include "game.h"
#include "nvm.h"

#include <zephyr/logging/log.h>
LOG_MODULE_REGISTER(game, LOG_LEVEL_DBG);


/*****************************************
 * Function definitions
 *****************************************/
static void show_start_screen(void);
static void show_game_screen(void);
static int handle_game_run(controls_btn_states_t *control_inputs);
static void input_name(void);
static void show_score_board(controls_btn_states_t *control_inputs);
static void handle_trash(void);
static void handle_missiles(uint8_t fire_shot);
static int handle_colisions(void);

/*****************************************
 * Variable definitions
 *****************************************/
static game_state_t state;
static uint16_t game_area_x_left;
static uint16_t game_area_x_right;
static uint16_t game_area_y_top;
static uint16_t game_area_y_bottom;

static uint16_t current_player_postion_x;
static uint16_t current_player_postion_y;
static uint16_t player_postion_limit_x_left;
static uint16_t player_postion_limit_x_right;
static uint16_t player_postion_limit_y_top;
static uint16_t player_postion_limit_y_bottom;

static uint8_t missiles[MAX_MISSILE_COUNTER];
static uint8_t trash[MAX_TRASH_COUNTER];

static uint8_t current_level;
static uint32_t current_score;
static uint32_t high_score;

#define NVM_ID_SCORES 0
#define NVM_ID_NAMES  1

static uint32_t score_board_scores[SCORE_BOARD_ENTRIES];
static char score_board_names[SCORE_BOARD_ENTRIES][SCORE_BOARD_MAX_NAME_LENGTH];

char score_text[30];
char *score_text_ptr = (char *)&score_text[0];
uint8_t score_label_id;
uint8_t player_id;

static lv_point_t top_line_points[]=
{
    {
        .x=0,
        .y=11,
    },
    {
        .x=127,
        .y=11,
    }
};

void game_init(void)
{
    state = GAME_STATE_INIT;
    current_score=0;

    // reserve top pixels for displaying text 
    game_area_y_top=12;
    game_area_x_left =0;
    graphics_get_screen_size(&game_area_y_bottom, &game_area_x_right);

    // initialize missile array
    for(uint8_t i=0; i<MAX_MISSILE_COUNTER; i++)
    {
        missiles[i]=0xFF;
    }
    
    // initialize trash array
    for(uint8_t i=0; i<MAX_TRASH_COUNTER; i++)
    {
        trash[i]=0xFF;
    }

    // initialize scoreboard array
    for(uint8_t i=0; i<SCORE_BOARD_ENTRIES; i++)
    {
        score_board_scores[i]=0x0;
        score_board_names[i][0]='\0';
    }

    (void) nvm_read(NVM_ID_SCORES, &score_board_scores, sizeof(score_board_scores), false, NULL);
    (void) nvm_read(NVM_ID_NAMES, &score_board_names, sizeof(score_board_names), false, NULL);
}


void game_step(controls_btn_states_t *control_inputs)
{

    switch (state)
    {
        case GAME_STATE_INIT:
            state = GAME_STATE_START;
            break;
        case GAME_STATE_START:
            graphics_delete_all_objects();
            show_start_screen();
            state = GAME_STATE_PRE_RUN;
            break;
        case GAME_STATE_PRE_RUN:
            // show start screen until start is pressed 
            if(control_inputs->btn_start == 1)
            {
                graphics_delete_all_objects();
                show_game_screen();

                // initialize missile array
                for(uint8_t i=0; i<MAX_MISSILE_COUNTER; i++)
                {
                    missiles[i]=0xFF;
                }

                // initialize trash array
                for(uint8_t i=0; i<MAX_TRASH_COUNTER; i++)
                {
                    trash[i]=0xFF;
                }
                
                current_score=0;
                current_level=0;
                state = GAME_STATE_RUN;
            }
            break;
        case GAME_STATE_RUN:
            // return value is negative if player died
            if(handle_game_run(control_inputs) != 0)
            {
                LOG_INF("Player scored %u points", current_score);
                graphics_delete_all_objects();
                if(current_score > score_board_scores[SCORE_BOARD_ENTRIES-1])
                {
                    input_name();
                    state = GAME_STATE_POST_RUN;
                }
                else
                {
                    state = GAME_STATE_SCORE_BOARD;
                }
            }
            break;
        case GAME_STATE_POST_RUN:
            // enter name for new score entry
            //state = GAME_STATE_PRE_SCORE_BOARD;
            break;
        case GAME_STATE_PRE_SCORE_BOARD:
            // state change is done in cb function
            graphics_delete_all_objects();
            show_score_board(control_inputs);
            state = GAME_STATE_SCORE_BOARD;
            break;
        case GAME_STATE_SCORE_BOARD:
                
            // show scoreboard until start is pressed
            if(control_inputs->btn_start == 1)
            {
                state = GAME_STATE_START;
            }
            break;
        default:
            break;
    }
}

static void show_start_screen(void)
{
    char high_score_text[30];
    char *high_score_text_ptr = (char *)&high_score_text[0];

    // set title
    uint8_t title=graphics_draw_text("Space Trash", 0, 0, 20);
    graphics_set_alignment(title, LV_TEXT_ALIGN_CENTER);
    // display high score
    sprintf( high_score_text_ptr,"High Score: %u", score_board_scores[0]);
    uint8_t high_score_label =graphics_draw_text(high_score_text_ptr, 0, 25, 10);  
    graphics_set_alignment(high_score_label, LV_TEXT_ALIGN_CENTER);
    // set title
    uint8_t start=graphics_draw_text("Press Start!", 0, 40, 16);
    graphics_set_alignment(start, LV_TEXT_ALIGN_CENTER);
    
    return;
}


static void show_game_screen(void)
{
    sprintf( score_text_ptr,"Lvl: %3u Score: %5u", current_level, current_score);
    score_label_id =graphics_draw_text(score_text_ptr, 0, 0, 10);
    // the reference to line object is not required by the game
    (void)graphics_draw_line(&top_line_points, 2, 2);

    current_player_postion_x=0;
    current_player_postion_y = game_area_y_top+((game_area_y_bottom-game_area_y_top)>>1);

    player_postion_limit_x_left=game_area_x_left;
    player_postion_limit_x_right=game_area_x_right-7; // initial ship is 7 pixel wide
    player_postion_limit_y_top=game_area_y_top;
    player_postion_limit_y_bottom=game_area_y_bottom-8; // initil ship is 8 pixel high

    player_id = graphics_draw_image(&st_bitmap_player1, current_player_postion_x, current_player_postion_y);
}

static int handle_game_run(controls_btn_states_t *control_inputs)
{
    int16_t move_x=0, move_y=0;
    static uint16_t iteration_cnt=0;

    if((MAX_TRASH_COOLDOWN-(LEVEL_COOLDOWN_REDUCTION*current_level))>=MIN_TRASH_COOLDOWN)
    {
        if(iteration_cnt >= ITERATIONS_PER_LEVEL)
        {
            iteration_cnt=0;
            current_level++;
        }
        else
        {
            iteration_cnt++;
        }
    }


    if(control_inputs->btn_up==1)
    {
        if(current_player_postion_y > player_postion_limit_y_top)
        {
            move_y=-PLAYER_SPEED;
            current_player_postion_y-=PLAYER_SPEED;
        }
    }
    else if(control_inputs->btn_down==1)
    {
        if(current_player_postion_y < player_postion_limit_y_bottom)
        {
            move_y=PLAYER_SPEED;
            current_player_postion_y+=PLAYER_SPEED;
        }
    }

    if(control_inputs->btn_left==1)
    {
        if(current_player_postion_x > player_postion_limit_x_left)
        {
            move_x=-PLAYER_SPEED;
            current_player_postion_x-=PLAYER_SPEED;
        }
    }
    else if(control_inputs->btn_right==1)
    {
        if(current_player_postion_x < player_postion_limit_x_right)
        {
            move_x=PLAYER_SPEED;
            current_player_postion_x+=PLAYER_SPEED;
        }
    }

    handle_missiles(control_inputs->btn_a );
    handle_trash();

    graphics_move_object(player_id, move_x, move_y, false);

    int ret = handle_colisions();
    sprintf(score_text_ptr,"Lvl: %3u Score: %5u", current_level, current_score);
    graphics_set_text(score_label_id, score_text_ptr);
    

    return ret;
}

static void handle_missiles(uint8_t fire_shot)
{
    static uint8_t fire_counter=0;
    
    uint8_t fresh_missile=0xff;

    if(fire_shot != 0 && fire_counter ==0)
    {
        // find free slot for missile 
        for(uint8_t i=0; i<MAX_MISSILE_COUNTER; i++)
        {
            if(missiles[i]==0xFF)
            {
                missiles[i] = graphics_draw_image(&st_bitmap_missile, current_player_postion_x+7, current_player_postion_y+1);
                // check if missile was created
                if(missiles[i] != 0xFF)
                {
                    LOG_DBG("Missile spawned at %u:%u", current_player_postion_x+7, current_player_postion_y+1);
                    fresh_missile=i;
                    // reset fire counter
                    fire_counter = MISSILE_COOLDOWN;
                }
                break;
            }
        }
    }
    else if(fire_counter > 0)
    {
        fire_counter--;
    }

    // iterate over all missiles and move 
    for(uint8_t i=0; i<MAX_MISSILE_COUNTER; i++)
    {
        if(missiles[i]!=0xFF && fresh_missile!=i)
        {
            int16_t x,y;
            int ret=0;
            
            ret = graphics_move_object(missiles[i], MISSILE_SPEED, 0, false);
            if(ret == 0)
            {
                // the existance of the graphics object was already estiblished, hence the return values can be ignored
                (void)graphics_get_object_position(missiles[i],&x, &y);
                // missile went out of screen
                if(x >=game_area_x_right)
                {
                    LOG_DBG("Missile left game area at %u:%u", x, y);
                    (void)graphics_delete_object(missiles[i]);
                    missiles[i] = 0xFF;
                }
                else
                {
                    LOG_DBG("Missile moved to %u:%u", x, y);
                }
            }
            // graphics object doesnt seem to exist, clear it from missile array
            else
            {
                missiles[i] = 0xFF;
            }
        }
    }
}

static void handle_trash(void)
{
    static uint8_t trash_cooldown=0;
    uint8_t fresh_trash = 0xff;

    if(trash_cooldown ==0)
    {
        // find free slot for trash 
        for(uint8_t i=0; i<MAX_TRASH_COUNTER; i++)
        {
            if(trash[i]==0xFF)
            {
                uint8_t trash_type = rand() % 3;

                if(trash_type ==0)
                {
                    int16_t y_pos = game_area_y_top + (rand() % (game_area_y_bottom-game_area_y_top-5));
                    trash[i] = graphics_draw_image(&st_bitmap_trash_5x5_1, game_area_x_right, y_pos);
                    LOG_DBG("Spawning trash trash_5x5_1 at %u:%u", game_area_x_right, y_pos);
                }
                else if(trash_type==1)
                {
                    int16_t y_pos = game_area_y_top + (rand() % (game_area_y_bottom-game_area_y_top-5));
                    trash[i] = graphics_draw_image(&st_bitmap_trash_5x5_2, game_area_x_right, y_pos);    
                    LOG_DBG("Spawning trash trash_5x5_2 at %u:%u", game_area_x_right, y_pos);
                }
                else
                {
                    int16_t y_pos = game_area_y_top + (rand() % (game_area_y_bottom-game_area_y_top-7));
                    trash[i] = graphics_draw_image(&st_bitmap_trash_7x7, game_area_x_right, y_pos);
                    LOG_DBG("Spawning trash trash_7x7 at %u:%u", game_area_x_right, y_pos);
                }

                // check if trash was created
                if(trash[i] != 0xFF)
                {
                    fresh_trash=i;
                    // reset trash cooldown, reduced by current level
                    if((MAX_TRASH_COOLDOWN-(LEVEL_COOLDOWN_REDUCTION*current_level))>=MIN_TRASH_COOLDOWN)
                    {
                        trash_cooldown = MAX_TRASH_COOLDOWN-LEVEL_COOLDOWN_REDUCTION*current_level;
                    }
                    else
                    {
                        trash_cooldown = MIN_TRASH_COOLDOWN;
                    }   
                }
                else
                {
                    LOG_WRN("Spawning trash unsuccesful");
                }
                break;
            }
        }
    } 
    else
    {
        trash_cooldown--;
    }
    
    // iterate over all missiles and move 
    for(uint8_t i=0; i<MAX_TRASH_COUNTER; i++)
    {
        if(trash[i]!=0xFF && fresh_trash!=i)
        {
            int16_t x,y;
            int ret=0;
            
            ret = graphics_move_object(trash[i], -TRASH_SPEED, 0, false);
            if(ret == 0)
            {
                // the existance of the graphics object was already estiblished, hence the return values can be ignored
                (void)graphics_get_object_position(trash[i],&x, &y);
                // trash went out of screen
                if(x <=game_area_x_left)
                {
                    LOG_DBG("Trash left game area at %u:%u", x, y);
                    (void)graphics_delete_object(trash[i]);
                    trash[i] = 0xFF;
                }
                else
                {
                    LOG_DBG("Trash moved to %u:%u", x, y);
                }
            }
            // graphics object doesnt seem to exist, clear it from trash array
            else
            {
                trash[i] = 0xFF;
            }
        }
    }
}

static int handle_colisions(void)
{
    int16_t current_player_postion_x_right,current_player_postion_y_bottom;
    int16_t player_height, player_width;

    (void)graphics_get_object_dimensions(player_id,&player_height, &player_width);
    
    current_player_postion_x_right = current_player_postion_x+player_width;
    current_player_postion_y_bottom = current_player_postion_y+player_height;

    for(uint8_t trash_id=0; trash_id<MAX_TRASH_COUNTER; trash_id++)
    {
        if(trash[trash_id] != 0xFF)
        {
            int16_t x_trash_left,y_trash_top, x_trash_right,y_trash_bottom;
            int16_t trash_height, trash_width;
            bool colision_detected = false;

            (void)graphics_get_object_position(trash[trash_id],&x_trash_left, &y_trash_top);
            (void)graphics_get_object_dimensions(trash[trash_id],&trash_height, &trash_width);

            x_trash_right = x_trash_left + trash_width;
            y_trash_bottom = y_trash_top + trash_height;
            
            // check if overarching rectangels of the trash and player overlay 
            if( x_trash_left < current_player_postion_x_right && 
                x_trash_right > current_player_postion_x &&
                y_trash_top < current_player_postion_y_bottom &&
                y_trash_bottom > current_player_postion_y
                )
            {
                LOG_INF("Trash colided with player");
                // colision with player detected, end game
                return -1;
            }

            for(uint8_t missile_id=0; missile_id < MAX_MISSILE_COUNTER; missile_id++)
            {
                if(missiles[missile_id] != 0xFF)
                {
                    int16_t x_missile_left,y_missile_top, x_missile_right,y_missile_bottom;
                    int16_t missile_height, missile_width;
                    (void)graphics_get_object_position(missiles[missile_id],&x_missile_left, &y_missile_top);
                    (void)graphics_get_object_dimensions(missiles[missile_id],&missile_height, &missile_width);

                    x_missile_right = x_missile_left + missile_width;
                    y_missile_bottom = y_missile_top + missile_height;

                    // check if overarching rectangels of the objects overlay 
                    if( x_trash_left < x_missile_right && 
                        x_trash_right > x_missile_left &&
                        y_trash_top < y_missile_bottom &&
                        y_trash_bottom > y_missile_top
                      )
                    {
                        // colision detected
                        (void)graphics_delete_object(trash[trash_id]);
                        (void)graphics_delete_object(missiles[missile_id]);
                        trash[trash_id] = 0xFF;
                        missiles[missile_id] = 0xFF;
                        colision_detected = true;
                        
                        // size of trash == score to eliminate trash
                        current_score+=trash_height;

                        LOG_INF("Missile and trash colission");

                        break;
                    }
                }
            }

            if(colision_detected == true)
            {
                break;
            }
        }
    }

    return 0;
}

static void submit_name(const char *name)
{

    for(uint8_t i=0; i < SCORE_BOARD_ENTRIES; i++ )
    {
        if(current_score > score_board_scores[i])
        {
            for(uint8_t j=SCORE_BOARD_ENTRIES-1; j > i; j-- )
            {
                score_board_scores[j] = score_board_scores[j-1];
                if(score_board_scores[j] > 0 )
                {
                    strncpy(&score_board_names[j],&score_board_names[j-1], SCORE_BOARD_MAX_NAME_LENGTH);
                }
            }

            score_board_scores[i] = current_score;
            strncpy(&score_board_names[i],name, SCORE_BOARD_MAX_NAME_LENGTH);
            LOG_DBG("New Score at %u: %s - %u\n", i+1,  &score_board_names[i],  score_board_scores[i]);
            break;
        }
    }

    (void) nvm_write(NVM_ID_SCORES, &score_board_scores, sizeof(score_board_scores));
    (void) nvm_write(NVM_ID_NAMES, &score_board_names, sizeof(score_board_names));

    state = GAME_STATE_PRE_SCORE_BOARD;
}

static void input_name(void)
{
    uint8_t name_lbl=graphics_draw_text("Name:", 0, 5, 10);
    uint8_t text_area=graphics_create_text_area(32, -5, 10, SCORE_BOARD_MAX_NAME_LENGTH, 10);
    uint8_t keyboard=graphics_text_input_screen(0, 24, 44, text_area, &submit_name);

    return;
}

static void show_score_board(controls_btn_states_t *control_inputs)
{
    uint16_t col_width[2];
    col_width[0] = 64;
    col_width[1] = 64;
    uint8_t highsores = graphics_draw_text("Highscores", 0, 0, 10);
    graphics_set_alignment(highsores, LV_TEXT_ALIGN_CENTER);

    uint8_t start = graphics_draw_text("Press START to continue", 0, 54, 10);
    graphics_set_alignment(start, LV_TEXT_ALIGN_CENTER);

    uint8_t table = graphics_draw_table(0,16, 128, 64, SCORE_BOARD_ENTRIES, 2, & col_width, 10);
    LOG_DBG("Scoreboard:\n");

    for(uint8_t i =0; i< SCORE_BOARD_ENTRIES ; i++)
    {
        if(score_board_scores[i] == 0)
        {
            break;
        }

        char score[11];
        sprintf(&score, "%10u", score_board_scores[i]);

        graphics_table_set_cell_value(table, i, 0, &score_board_names[i]);
        graphics_table_set_cell_value(table, i, 1, &score);
        LOG_DBG("Position %u: %s - %u\n", i+1,  &score_board_names[i],  score_board_scores[i]);
    }

    return;
}
```
