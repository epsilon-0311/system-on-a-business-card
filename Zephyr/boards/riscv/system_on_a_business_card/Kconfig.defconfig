## Zephyr/boards/riscv/system_on_a_business_card/Kconfig.defconfig
```kconfig
# System on a Business Card board configuration
if BOARD_SYSTEM_ON_A_BUSINESS_CARD

	# Copyright (c) 2021 Espressif Systems (Shanghai) Co., Ltd.
	# SPDX-License-Identifier: Apache-2.0

	config BOARD
		default "system_on_a_business_card"


	if BT

		config HEAP_MEM_POOL_SIZE
			default 16384

		choice BT_HCI_BUS_TYPE
			default BT_ESP32
		endchoice

	endif # BT

endif # BOARD_SYSTEM_ON_A_BUSINESS_CARD
```

## Zephyr/workspace/boards/riscv/system_on_a_business_card/Kconfig.board
```kconfig
# ESP32C3 devkitm board configuration

# Copyright (c) 2021 Espressif Systems (Shanghai) Co., Ltd.
# SPDX-License-Identifier: Apache-2.0

config BOARD_SYSTEM_ON_A_BUSINESS_CARD
	bool "System on a Buisiness Card"
	depends on SOC_ESP32C3
	select CONSOLE_HAS_DRIVER
```

## Zephyr/workspace/boards/riscv/system_on_a_business_card/Kconfig.defconfig
```kconfig
# System on a Business Card board configuration
if BOARD_SYSTEM_ON_A_BUSINESS_CARD

	# Copyright (c) 2021 Espressif Systems (Shanghai) Co., Ltd.
	# SPDX-License-Identifier: Apache-2.0

	config BOARD
		default "system_on_a_business_card"


	if BT
		config HEAP_MEM_POOL_SIZE
			default 16384

		choice BT_HCI_BUS_TYPE
			default BT_ESP32
		endchoice

	endif # BT

	if DISPLAY

		if LVGL

			config LV_Z_VDB_SIZE
				default 64

			config LV_DPI_DEF
				default 148

			config LV_Z_BITS_PER_PIXEL
				default 1

			choice LV_COLOR_DEPTH
				default LV_COLOR_DEPTH_1
			endchoice

		endif # LVGL

	endif # DISPLAY

endif # BOARD_SYSTEM_ON_A_BUSINESS_CARD
```

## Zephyr/workspace/drivers/display/Kconfig
```kconfig
# Display drivers

# Copyright (c) 2017 Intel Corporation
# SPDX-License-Identifier: Apache-2.0

if DISPLAY

rsource "ssd1312/Kconfig"

endif # DISPLAY
```

## Zephyr/workspace/drivers/display/ssd1312/Kconfig
```kconfig
# SSD1312 display controller configuration options

# Copyright (c) 2018 Phytec Messtechnik GmbH
# SPDX-License-Identifier: Apache-2.0

DT_COMPAT_SOLOMON_SSD1312FB := solomon,ssd1312fb

config SSD1312
	bool "SSD1312 display driver"
	default y
	depends on DT_HAS_SOLOMON_SSD1312FB_ENABLED
	select I2C if $(dt_compat_on_bus,$(DT_COMPAT_SOLOMON_SSD1312FB),i2c)
	help
	  Enable driver for SSD1312 display driver.

if SSD1312

config SSD1312_DEFAULT_CONTRAST
	int "SSD1312 default contrast"
	default 128
	range 0 255 
	help
	  SSD1312 default contrast.

choice SSD1312_CONTROLLER_TYPE
	prompt "Display controller type"
	default SSD1312_DEFAULT
	help
	  Specify the type of the controller.

config SSD1312_DEFAULT
	bool "Default SSD1312 controller"

endchoice

config SSD1312_REVERSE_MODE
	bool "SSD1312 reverse mode"
	help
	  SSD1312 reverse video mode. 

endif # SSD1312
```
